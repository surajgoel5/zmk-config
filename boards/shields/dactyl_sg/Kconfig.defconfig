## boards/shields/dactyl_sg/Kconfig.defconfig
```kconfig
if SHIELD_DACTYL_SG_LEFT

config ZMK_KEYBOARD_NAME
    default "dactyl-sg"

config ZMK_SPLIT_ROLE_CENTRAL
    default y

endif # SHIELD_DACTYL_SG_LEFT

if SHIELD_DACTYL_SG_LEFT || SHIELD_DACTYL_SG_RIGHT

config ZMK_SPLIT
    default y

endif # SHIELD_DACTYL_SG_LEFT || SHIELD_DACTYL_SG_RIGHT
```

## boards/shields/dactyl_sg/Kconfig.shield
```kconfig
config SHIELD_DACTYL_SG_LEFT
    def_bool $(shields_list_contains,dactyl_sg_left)

config SHIELD_DACTYL_SG_RIGHT
    def_bool $(shields_list_contains,dactyl_sg_right)
```

## boards/shields/dactyl_suraj/Kconfig.defconfig
```kconfig
if SHIELD_DACTYL_SURAJ_LEFT

config ZMK_KEYBOARD_NAME
    default "Dactyl-Suraj"

config ZMK_SPLIT_ROLE_CENTRAL
    default y

endif # SHIELD_DACTYL_SURAJ_LEFT

if SHIELD_DACTYL_SURAJ_LEFT || SHIELD_DACTYL_SURAJ_RIGHT

config ZMK_SPLIT
    default y

endif # SHIELD_DACTYL_SURAJ_LEFT || SHIELD_DACTYL_SURAJ_RIGHT
```

## boards/shields/dactyl_suraj/Kconfig.shield
```kconfig
config SHIELD_DACTYL_SURAJ_LEFT
    def_bool $(shields_list_contains,dactyl_suraj_left)

config SHIELD_DACTYL_SURAJ_RIGHT
    def_bool $(shields_list_contains,dactyl_suraj_right)
```
