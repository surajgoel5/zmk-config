#include "dactyl_suraj.dtsi"


&default_transform {
    col-offset = <6>;
};



&kscan0 {

        col-gpios =
            <&gpio0 24 GPIO_ACTIVE_HIGH>,
            <&gpio1 6  GPIO_ACTIVE_HIGH>,
            <&gpio0 17 GPIO_ACTIVE_HIGH>,
            <&gpio0 20 GPIO_ACTIVE_HIGH>,
            <&gpio0 22 GPIO_ACTIVE_HIGH>,
            <&gpio0 29 GPIO_ACTIVE_HIGH>,
            <&gpio0 31 GPIO_ACTIVE_HIGH>;
};
	
	