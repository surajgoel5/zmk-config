#include "dactyl_suraj.dtsi"




&kscan0 {
			
        col-gpios =
            <&gpio1 0 GPIO_ACTIVE_HIGH>, 
            <&gpio0 6  GPIO_ACTIVE_HIGH>,
            <&gpio0 17 GPIO_ACTIVE_HIGH>,
            <&gpio0 22 GPIO_ACTIVE_HIGH>,
            <&gpio0 24 GPIO_ACTIVE_HIGH>,
            <&gpio0 31 GPIO_ACTIVE_HIGH>;
};
