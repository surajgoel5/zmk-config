#include <dt-bindings/zmk/matrix_transform.h>
#include "dactyl_suraj-layouts.dtsi"

/ {
    
	 kscan0: kscan {
        compatible = "zmk,kscan-gpio-matrix";
        label = "KSCAN";
        wakeup-source;

        diode-direction = "col2row";
		
        row-gpios =
            <&gpio1 15 (GPIO_ACTIVE_HIGH | GPIO_PULL_DOWN)>,
            <&gpio1 13 (GPIO_ACTIVE_HIGH | GPIO_PULL_DOWN)>,
            <&gpio1 11 (GPIO_ACTIVE_HIGH | GPIO_PULL_DOWN)>,
            <&gpio0 10 (GPIO_ACTIVE_HIGH | GPIO_PULL_DOWN)>,
            <&gpio0 2  (GPIO_ACTIVE_HIGH | GPIO_PULL_DOWN)>,
            <&gpio0 11 (GPIO_ACTIVE_HIGH | GPIO_PULL_DOWN)>;
    };
 
};